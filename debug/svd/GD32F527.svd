# GD32F527 register map
File version: 1.0
GD32F527 ARM 32-bit Cortex-M33 Microcontroller based device
CPU: CM33 r0p1, little endian, MPU, FPU, 4 interrupt priority bits
Registers are 32-bit, read-write, reset 0x0 unless marked. A register's access mark holds for its fields unless they carry their own. Offsets are from the block's base; lines under a group give offsets from that group; [hi:lo] are bit positions; {n}, {i} and the like mark numbered series; 'fields as' and 'values as' point back to an identical list; <NAME> marks a mode.

## Memory map
0x40000000 TIMER1 size 0x400 — General-purpose-timers
0x40000400 TIMER2 size 0x400
0x40000800 TIMER3 size 0x400
0x40000C00 TIMER4 size 0x400
0x40001000 TIMER5 size 0x400 — Basic timer
0x40001400 TIMER6 size 0x400
0x40001800 TIMER11 size 0x400
0x40001C00 TIMER12 size 0x400
0x40002000 TIMER13 size 0x400
0x40002800 RTC size 0x400 — Real time clock
0x40002C00 WWDGT size 0x400 — Window watchdog timer
0x40003000 FWDGT size 0x400 — Free watchdog timer
0x40003400 I2S1_add size 0x400
0x40003800 SPI1 size 0x400
0x40003C00 SPI2 size 0x400
0x40004000 I2S2_add size 0x400
0x40004400 USART1 size 0x400
0x40004800 USART2 size 0x400
0x40004C00 UART3 size 0x400 — Universal asynchronous receiver transmitter
0x40005000 UART4 size 0x400
0x40005400 I2C0 size 0x400 — Inter-integrated circuit interface
0x40005800 I2C1 size 0x400
0x40005C00 I2C2 size 0x400
0x40006400 CAN0 size 0x400 — Controller area network
0x40006800 CAN1 size 0x400
0x40006C00 CTC size 0x400 — Clock trim controller
0x40007000 PMU size 0x400 — Power management unit
0x40007400 DAC size 0x400 — Digital-to-analog converter
0x40007800 UART6 size 0x400
0x40007C00 UART7 size 0x400
0x40008000 I2C3 size 0x400 — Inter-integrated circuit interface
0x40008400 I2C4 size 0x400
0x40008800 I2C5 size 0x400
0x4000C400 IREF size 0x400 — Programmable current reference
0x40010000 TIMER0 size 0x400 — Advanced timer
0x40010400 TIMER7 size 0x400
0x40011000 USART0 size 0x400 — Universal synchronous asynchronous receiver transmitter
0x40011400 USART5 size 0x400
0x40012000 ADC0 size 0x100 — Analog to digital converter
0x40012100 ADC1 size 0x100
0x40012200 ADC2 size 0x100
0x40012300 ADC_Common size 0x100 — common ADC register
0x40012C00 SDIO size 0x400 — Secure digital input/output interface
0x40013000 SPI0 size 0x400 — Serial peripheral interface/Inter-IC sound
0x40013400 SPI3 size 0x400
0x40013800 SYSCFG size 0x400 — System and memory architectur
0x40013C00 EXTI size 0x400 — Interrupt / event controller
0x40014000 TIMER8 size 0x400 — General level1 timer
0x40014400 TIMER9 size 0x400 — General-purpose-timers
0x40014800 TIMER10 size 0x400 — General level2 timer
0x40015000 SPI4 size 0x400
0x40015400 SPI5 size 0x400 — Serial peripheral interface/Inter-IC sound
0x40015800 SAI size 0x400 — Serial Audio Interface
0x40016800 TLI size 0x400 — TFT-LCD interface
0x40020000 GPIOA size 0x400 — General-purpose I/Os
0x40020400 GPIOB size 0x400 — General-purpose I/Os
0x40020800 GPIOC size 0x400 — General-purpose I/Os
0x40020C00 GPIOD size 0x400
0x40021000 GPIOE size 0x400
0x40021400 GPIOF size 0x400
0x40021800 GPIOG size 0x400
0x40021C00 GPIOH size 0x400
0x40022000 GPIOI size 0x400
0x40023000 CRC size 0x400 — Cyclic redundancy checks management unit
0x40023800 RCU size 0x400 — Reset and clock unit
0x40023C00 FMC size 0x400 — Flash memory controller
0x40026000 DMA0 size 0x400 — DMA controller
0x40026400 DMA1 size 0x400
0x40028000 ENET_MAC size 0x100 — Ethernet: media access control
0x40028100 ENET_MSC size 0x400 — Ethernet: MAC statistics counters
0x40028700 ENET_PTP size 0x400 — Ethernet: Precision time protocol
0x40029000 ENET_DMA size 0x60 — Ethernet: DMA controller operation
0x40029080 ENET_MAC_FCTH size 0x20 — MAC flow control threshold register
0x4002B000 IPA size 0x400 — Image processing accelerator
0x40040000 HS_GLOBAL size 0x400 — USB high speed global registers
0x40040400 HS_HOST size 0x400 — USB on the go full speed host
0x40040800 HS_DEVICE size 0x400 — USB on the go high speed device
0x40040E00 HS_PWRCLK size 0x100 — USB on the go high speed power and clock
0x50000000 FS_GLOBAL size 0x400 — USB full speed global registers
0x50000400 FS_HOST size 0x400 — USB on the go full speed host
0x50000800 FS_DEVICE size 0x400 — USB on the go full speed device
0x50000E00 FS_PWRCLK size 0x100 — USB on the go full speed
0x50050000 DCI size 0x400 — Digital camera interface
0x50060000 CAU size 0x400 — Cryptographic Acceleration Unit
0x50060400 HAU size 0x400 — Hash Acceleration Unit
0x50060800 TRNG size 0x400 — True random number generator
0x50061000 PKCAU size 0x400 — Public Key Cryptographic Acceleration Unit
0xA0000000 EXMC size 0x1000 — External memory controller
0xE0044000 DBG size 0x400 — Debug

## Interrupts
0 WWDGT
1 LVD (PMU)
2 RTC_Tamper (RTC)
3 RTC_WKUP (RTC)
4 FMC
5 RCU_CTC (CTC, RCU)
6 EXTI_Line0 (EXTI)
7 EXTI_Line1 (EXTI)
8 EXTI_Line2 (EXTI)
9 EXTI_Line3 (EXTI)
10 EXTI_Line4 (EXTI)
11 DMA0_Channel0 (DMA0)
12 DMA0_Channel1 (DMA0)
13 DMA0_Channel2 (DMA0)
14 DMA0_Channel3 (DMA0)
15 DMA0_Channel4 (DMA0)
16 DMA0_Channel5 (DMA0)
17 DMA0_Channel6 (DMA0)
18 ADC (ADC{n} (n=0..2))
19 CAN0_TX (CAN0)
20 CAN0_RX0 (CAN0)
21 CAN0_RX1 (CAN0)
22 CAN0_EWMC (CAN0)
23 EXTI_line9_5 (EXTI)
24 TIMER0_BRK_TIMER8 (TIMER0)
25 TIMER0_UP_TIMER9 (TIMER0, TIMER9)
26 TIMER0_TRG_CMT_TIMER10 (TIMER0)
27 TIMER0_CC (TIMER0)
28 TIMER1
29 TIMER2
30 TIMER3
31 I2C0_EV (I2C0)
32 I2C0_ER (I2C0)
33 I2C1_EV (I2C1)
34 I2C1_ER (I2C1)
35 SPI0
36 SPI1
37 USART0
38 USART1
39 USART2
40 EXTI_line15_10 (EXTI)
41 RTC_Alarm (RTC)
42 OTG_FS_WKUP (FS_GLOBAL)
43 TIMER7_BRK_TIMER11 (TIMER7, TIMER11)
44 TIMER7_UP_TIMER12 (TIMER7, TIMER12)
45 TIMER7_TRG_CMT_TIMER13 (TIMER7, TIMER13)
46 TIMER7_CC (TIMER7)
47 DMA0_Channel7 (DMA0)
48 EXMC
49 SDIO
50 TIMER4
51 SPI2
52 UART3
53 UART4
54 TIMER5_DAC (DAC)
55 TIMER6
56 DMA1_Channel0 (DMA1)
57 DMA1_Channel1 (DMA1)
58 DMA1_Channel2 (DMA1)
59 DMA1_Channel3 (DMA1)
60 DMA1_Channel4 (DMA1)
61 ENET (ENET_MAC)
62 ENET_WKUP (ENET_MAC)
63 CAN1_TX (CAN1)
64 CAN1_RX0 (CAN1)
65 CAN1_RX1 (CAN1)
66 CAN1_EWMC (CAN1)
67 OTG_FS (FS_GLOBAL)
68 DMA1_Channel5 (DMA1)
69 DMA1_Channel6 (DMA1)
70 DMA1_Channel7 (DMA1)
71 USART5
72 I2C2_EV (I2C2)
73 I2C2_ER (I2C2)
74 USBHS_EP1_Out (HS_GLOBAL)
75 USBHS_EP1_In (HS_GLOBAL)
76 USBHS_WKUP (HS_GLOBAL)
77 USBHS (HS_GLOBAL)
78 DCI
80 TRNG
81 FPU (EXTI)
82 UART6
83 UART7
84 SPI3
85 SPI4
86 SPI5
87 SAI
88 TLI
89 TLI_ER (TLI)
90 IPA
91 PKCAU
92 I2C3_EV (I2C3)
93 I2C3_ER (I2C3)
94 I2C4_EV (I2C4)
95 I2C4_ER (I2C4)
96 I2C5_EV (I2C5)
97 I2C5_ER (I2C5)
98 I2C3_WAKE (I2C3)
99 I2C4_WAKE (I2C4)
100 I2C5_WAKE (I2C5)
102 HAU
103 CAU
